## CMakeLists.txt
```
cmake_minimum_required(VERSION 3.16)
project(zephyr_can_rate_limiter LANGUAGES C)

set(CMAKE_C_STANDARD 11)
set(CMAKE_C_STANDARD_REQUIRED ON)
set(CMAKE_C_EXTENSIONS OFF)

add_library(zephyr_can_rate_limiter STATIC
    src/zephyr_can_rate_limiter.c
)

target_include_directories(zephyr_can_rate_limiter PUBLIC
    ${CMAKE_CURRENT_SOURCE_DIR}/include
)

target_compile_options(zephyr_can_rate_limiter PRIVATE
    -Wall -Wextra -Werror -Wpedantic
)

enable_testing()
add_executable(test_zephyr_can_c tests/test_zephyr_can_c.c)
target_link_libraries(test_zephyr_can_c PRIVATE zephyr_can_rate_limiter)
target_compile_options(test_zephyr_can_c PRIVATE -Wall -Wextra -Werror -Wpedantic)
add_test(NAME zephyr_can_c_tests COMMAND test_zephyr_can_c)
```

## prj.conf
```kconfig
# Zephyr RTOS CAN Subsystem Kconfig Overlay (ISO 11898-1 Hardening)
CONFIG_CAN=y
CONFIG_CAN_AUTO_BUS_OFF_RECOVERY=y
CONFIG_CAN_ERRINT_RATE_LIMITER=y
CONFIG_CAN_ERRINT_BURST_CAPACITY=10
CONFIG_CAN_ERRINT_REFILL_RATE_HZ=20
CONFIG_LOG=y
CONFIG_LOG_MODE_DEFERRED=y
CONFIG_LOG_BUFFER_SIZE=4096
```

## include/zephyr_can_rate_limiter.h
```c
/*
 * zephyr_can_rate_limiter.h
 * Deterministic Token-Bucket Error Interrupt Log Rate Limiter & ISO 11898-1
 * Bus-Off Recovery State Machine for Zephyr RTOS CAN Drivers
 *
 * Target Hardware: NXP FlexCAN (S32K3 / i.MX RT), STM32 FDCAN/bxCAN
 * Standard: ISO 11898-1:2015 | C11 Bare-Metal / Zephyr RTOS Subsys Compatible
 * Author: Engineer Abdullah Bin Zafar
 * License: Apache-2.0
 */

#ifndef ZEPHYR_CAN_RATE_LIMITER_H_
#define ZEPHYR_CAN_RATE_LIMITER_H_

#include <stdbool.h>
#include <stdint.h>

#ifdef __cplusplus
extern "C" {
#endif

/**
 * @brief ISO 11898-1:2015 CAN bus controller error states.
 */
typedef enum {
    CAN_CTRL_STATE_ERROR_ACTIVE = 0,  /**< TEC <= 96 and REC <= 96 */
    CAN_CTRL_STATE_ERROR_WARNING,     /**< TEC > 96 or REC > 96 */
    CAN_CTRL_STATE_ERROR_PASSIVE,     /**< TEC > 127 or REC > 127 */
    CAN_CTRL_STATE_BUS_OFF,           /**< TEC > 255 */
    CAN_CTRL_STATE_STOPPED            /**< Controller halted safely */
} can_ctrl_state_t;

/**
 * @brief In-ISR lock-free integer token-bucket rate limiter.
 * Uses scaled fixed-point micro-tokens (1 token = 1,000,000 units)
 * to preserve determinism without floating-point unit (FPU) state saving in ISRs.
 */
typedef struct {
    uint64_t micro_tokens;          /**< Available tokens * 1,000,000 */
    uint64_t max_micro_tokens;      /**< Burst capacity * 1,000,000 */
    uint32_t refill_per_ms_micro;   /**< Micro-tokens restored per millisecond */
    int64_t  last_refill_ms;        /**< Timestamp from k_uptime_get() (ms) */
    uint32_t suppressed_count;      /**< Logs suppressed since last emission */
    uint64_t total_allowed;         /**< Total diagnostics emitted */
    uint64_t total_suppressed;      /**< Lifetime suppressed interrupt storms */
} can_error_rate_limiter_t;

/**
 * @brief Decision result emitted on ISR log evaluation.
 */
typedef struct {
    bool     emit_log;              /**< True if caller may safely push to log ringbuf */
    uint32_t newly_reported_drops;  /**< Non-zero summary count if burst ended */
} can_log_decision_t;

/**
 * @brief Hardware controller fault state & diagnostics record.
 */
typedef struct {
    can_ctrl_state_t         state;
    uint16_t                 tec;                  /**< Transmit Error Counter (0..256+) */
    uint16_t                 rec;                  /**< Receive Error Counter (0..255) */
    uint64_t                 total_errint_fires;   /**< Total physical ERRINT IRQs */
    uint32_t                 recovery_recessive_seqs; /**< Consecutive 11-bit recessive seqs */
    can_error_rate_limiter_t limiter;
} can_fault_ctx_t;

/**
 * @brief Initialize token-bucket rate limiter without heap allocation.
 * @param limiter          Pointer to pre-allocated limiter struct.
 * @param capacity_tokens  Burst ceiling (e.g., 10 logs).
 * @param refill_per_sec   Sustained logs/sec (e.g., 20 logs/s).
 * @param initial_time_ms  Current monotonic kernel uptime in ms.
 * @return 0 on success, -1 on invalid arguments.
 */
int can_rate_limiter_init(can_error_rate_limiter_t *limiter,
                          uint32_t capacity_tokens,
                          uint32_t refill_per_sec,
                          int64_t initial_time_ms);

/**
 * @brief Evaluate O(1) ISR-safe log admission decision.
 * Uses pure integer arithmetic (zero FPU, zero dynamic allocation).
 * @param limiter  Limiter context.
 * @param now_ms   Monotonic timestamp in ms.
 * @return Admission flag and any flushed suppression summary counter.
 */
can_log_decision_t can_rate_limiter_eval(can_error_rate_limiter_t *limiter,
                                         int64_t now_ms);

/**
 * @brief Initialize simulated/hardware CAN fault diagnostics context.
 */
int can_fault_ctx_init(can_fault_ctx_t *ctx,
                       uint32_t log_capacity,
                       uint32_t log_refill_per_sec,
                       int64_t initial_time_ms);

/**
 * @brief Advance ISO 11898-1 error counters and state machine upon bus fault.
 * Per ISO 11898-1:2015 Section 12.1.4.2, TX bit/ACK error increments TEC by 8.
 * @param ctx    Fault controller context.
 * @param is_tx  True for TX fault (+8 TEC), false for RX fault (+1 REC).
 * @param now_ms Monotonic timestamp for ISR log throttling evaluation.
 * @return Log admission decision under fault burst.
 */
can_log_decision_t can_fault_inject_error(can_fault_ctx_t *ctx,
                                          bool is_tx,
                                          int64_t now_ms);

/**
 * @brief Attempt deterministic ISO 11898-1 Bus-Off auto-recovery.
 * Requires >= 128 sequences of 11 consecutive recessive bits on bus.
 * @param ctx                 Fault controller context.
 * @param recessive_seq_count Observed 11-bit recessive sequence count.
 * @return true if bus transitioned back to ERROR_ACTIVE, false otherwise.
 */
bool can_fault_attempt_bus_off_recovery(can_fault_ctx_t *ctx,
                                        uint32_t recessive_seq_count);

/**
 * @brief Convert controller error state to human-readable string.
 */
const char *can_ctrl_state_str(can_ctrl_state_t state);

#ifdef __cplusplus
}
#endif

#endif /* ZEPHYR_CAN_RATE_LIMITER_H_ */
```

## src/zephyr_can_rate_limiter.c
```c
/*
 * zephyr_can_rate_limiter.c
 * Deterministic In-ISR Token-Bucket Log Governor & ISO 11898-1:2015
 * CAN Controller Fault State Machine Implementation
 *
 * Zero dynamic heap allocation. Zero floating-point operations (ISR-safe).
 * Compiles cleanly under -std=c11 -Wall -Wextra -Werror.
 *
 * Author: Engineer Abdullah Bin Zafar
 * License: Apache-2.0
 */

#include "zephyr_can_rate_limiter.h"
#include <stddef.h>
#include <string.h>

#define MICRO_SCALE ((uint64_t)1000000ULL)
#define ISO11898_BUS_OFF_RECESSIVE_GOAL 128U

int can_rate_limiter_init(can_error_rate_limiter_t *limiter,
                          uint32_t capacity_tokens,
                          uint32_t refill_per_sec,
                          int64_t initial_time_ms)
{
    if (limiter == NULL || capacity_tokens == 0U || refill_per_sec == 0U) {
        return -1;
    }

    memset(limiter, 0, sizeof(*limiter));
    limiter->max_micro_tokens = (uint64_t)capacity_tokens * MICRO_SCALE;
    limiter->micro_tokens = limiter->max_micro_tokens;
    /* micro-tokens per ms = (refill_per_sec * 1,000,000) / 1000 = refill_per_sec * 1000 */
    limiter->refill_per_ms_micro = refill_per_sec * 1000U;
    limiter->last_refill_ms = initial_time_ms;
    return 0;
}

can_log_decision_t can_rate_limiter_eval(can_error_rate_limiter_t *limiter,
                                         int64_t now_ms)
{
    can_log_decision_t decision = { false, 0U };

    if (limiter == NULL) {
        return decision;
    }

    if (now_ms > limiter->last_refill_ms) {
        uint64_t delta_ms = (uint64_t)(now_ms - limiter->last_refill_ms);
        uint64_t added = delta_ms * (uint64_t)limiter->refill_per_ms_micro;

        /* Saturating addition bounded by burst ceiling */
        if (added >= limiter->max_micro_tokens ||
            limiter->micro_tokens + added >= limiter->max_micro_tokens) {
            limiter->micro_tokens = limiter->max_micro_tokens;
        } else {
            limiter->micro_tokens += added;
        }
        limiter->last_refill_ms = now_ms;
    }

    if (limiter->micro_tokens >= MICRO_SCALE) {
        limiter->micro_tokens -= MICRO_SCALE;
        decision.emit_log = true;
        decision.newly_reported_drops = limiter->suppressed_count;
        limiter->suppressed_count = 0U;
        limiter->total_allowed++;
    } else {
        decision.emit_log = false;
        limiter->suppressed_count++;
        limiter->total_suppressed++;
        decision.newly_reported_drops = 0U;
    }

    return decision;
}

static void update_iso11898_state(can_fault_ctx_t *ctx)
{
    /* ISO 11898-1:2015 Section 12.1.4 error state thresholds */
    if (ctx->tec > 255U) {
        ctx->state = CAN_CTRL_STATE_BUS_OFF;
    } else if (ctx->tec > 127U || ctx->rec > 127U) {
        ctx->state = CAN_CTRL_STATE_ERROR_PASSIVE;
    } else if (ctx->tec > 96U || ctx->rec > 96U) {
        ctx->state = CAN_CTRL_STATE_ERROR_WARNING;
    } else {
        ctx->state = CAN_CTRL_STATE_ERROR_ACTIVE;
    }
}

int can_fault_ctx_init(can_fault_ctx_t *ctx,
                       uint32_t log_capacity,
                       uint32_t log_refill_per_sec,
                       int64_t initial_time_ms)
{
    if (ctx == NULL) {
        return -1;
    }

    memset(ctx, 0, sizeof(*ctx));
    ctx->state = CAN_CTRL_STATE_ERROR_ACTIVE;
    return can_rate_limiter_init(&ctx->limiter,
                                 log_capacity,
                                 log_refill_per_sec,
                                 initial_time_ms);
}

can_log_decision_t can_fault_inject_error(can_fault_ctx_t *ctx,
                                          bool is_tx,
                                          int64_t now_ms)
{
    can_log_decision_t decision = { false, 0U };
    if (ctx == NULL || ctx->state == CAN_CTRL_STATE_STOPPED) {
        return decision;
    }

    ctx->total_errint_fires++;

    if (is_tx) {
        if (ctx->tec <= 255U) {
            ctx->tec += 8U;
        }
    } else {
        if (ctx->rec < 255U) {
            ctx->rec += 1U;
        }
    }

    update_iso11898_state(ctx);
    return can_rate_limiter_eval(&ctx->limiter, now_ms);
}

bool can_fault_attempt_bus_off_recovery(can_fault_ctx_t *ctx,
                                        uint32_t recessive_seq_count)
{
    if (ctx == NULL || ctx->state != CAN_CTRL_STATE_BUS_OFF) {
        return false;
    }

    ctx->recovery_recessive_seqs += recessive_seq_count;
    if (ctx->recovery_recessive_seqs >= ISO11898_BUS_OFF_RECESSIVE_GOAL) {
        ctx->tec = 0U;
        ctx->rec = 0U;
        ctx->recovery_recessive_seqs = 0U;
        ctx->state = CAN_CTRL_STATE_ERROR_ACTIVE;
        return true;
    }
    return false;
}

const char *can_ctrl_state_str(can_ctrl_state_t state)
{
    switch (state) {
        case CAN_CTRL_STATE_ERROR_ACTIVE:  return "ERROR_ACTIVE";
        case CAN_CTRL_STATE_ERROR_WARNING: return "ERROR_WARNING";
        case CAN_CTRL_STATE_ERROR_PASSIVE: return "ERROR_PASSIVE";
        case CAN_CTRL_STATE_BUS_OFF:       return "BUS_OFF";
        case CAN_CTRL_STATE_STOPPED:       return "STOPPED";
        default:                           return "UNKNOWN";
    }
}
```
